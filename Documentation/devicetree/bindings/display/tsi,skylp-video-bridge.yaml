## Documentation/devicetree/bindings/display/tsi,skylp-video-bridge.yaml
```yaml
# SPDX-License-Identifier: (GPL-2.0-only OR BSD-2-Clause)
%YAML 1.2
---
$id: http://devicetree.org/schemas/display/tsi,skylp-video-bridge.yaml#
$schema: http://devicetree.org/meta-schemas/core.yaml#

title: TSI SkyLP video bridge display controller

maintainers:
  - Mahesh Babu <maheshbabu@tsavoritesi.com>

description: |
  The Innosilicon UDI subsystem in TSI SkyLP carries two video bridges.
  Each reads a physically contiguous framebuffer over AXI and streams it,
  with timing, to the DisplayPort controller. A bridge holds four channels
  and a block of registers shared by them; this node drives channel 0 of
  one bridge as a single-stream CRTC.

  The bridge addresses 40 bits and sits behind no IOMMU, so scanout buffers
  must be contiguous. A memory-region can reserve them.

  The single output port connects to an input port of the DP controller
  node. The DP controller's driver resolves its possible CRTCs through
  that link, so both ends must be described.

properties:
  compatible:
    const: tsi,skylp-video-bridge

  reg:
    maxItems: 1
    description:
      The bridge register window, starting at channel 0 and covering the
      shared block at +0x200. Bridge 0 is at subsystem APB +0x400.

  interrupts:
    maxItems: 1
    description:
      The bridge's frame-done line, normally from the UDI interrupt
      collector. Optional; without it the display runs with no vblank and
      page-flip events complete at commit time.

  clocks:
    minItems: 1
    maxItems: 4
    description:
      Bus clocks the bridge needs enabled. The pixel clock is owned by the
      DP controller and is not listed here.

  memory-region:
    maxItems: 1
    description:
      Reserved memory to allocate scanout buffers from. Without it they
      come from the default CMA pool.

  port:
    $ref: /schemas/graph.yaml#/properties/port
    unevaluatedProperties: false
    description: Output to an input port of the DP controller.

required:
  - compatible
  - reg
  - port

additionalProperties: false

examples:
  - |
    display-controller@24010550 {
        compatible = "tsi,skylp-video-bridge";
        reg = <0x24010550 0x400>;
        interrupt-parent = <&udi_intc>;
        interrupts = <2 4>;

        port {
            vb0_out: endpoint {
                remote-endpoint = <&dp_in0>;
            };
        };
    };

    dp@24050150 {
        compatible = "soc,dp";
        reg = <0x24050150 0x40000>;
        phys = <&dp_phy>;
        phy-names = "phy";
        clocks = <&dp_phy 0>;
        clock-names = "pixel-0";

        ports {
            #address-cells = <1>;
            #size-cells = <0>;

            port@0 {
                reg = <0>;
                dp_in0: endpoint {
                    remote-endpoint = <&vb0_out>;
                };
            };
        };
    };
...
```

## Documentation/devicetree/bindings/gpio/tsi,skylp-gpio.yaml
```yaml
# SPDX-License-Identifier: (GPL-2.0-only OR BSD-2-Clause)
%YAML 1.2
---
$id: http://devicetree.org/schemas/gpio/tsi,skylp-gpio.yaml#
$schema: http://devicetree.org/meta-schemas/core.yaml#

title: TSI SkyLP IO-corner GPIO controller

maintainers:
  - Tsavorite Scalable Intelligence BMC team

description:
  Dedicated GPIO pads of one SkyLP IO corner (IONW GPIO_0..7, IONE
  fail-safe GPIO_FS_0..3). Must be a child of a tsi,skylp-chiplet
  node; reg is the corner block offset within the chiplet CSR window
  and all access goes through the chiplet core.

  Pin events latch in the corner's interrupt collector, which fans out
  to four maskable destination groups (g0..g3); one of them is meant
  to reach the A520 GIC as an SPI. The driver supports acting as an
  interrupt-controller, but this is dormant unless "interrupts" is
  present: the collector-to-GIC wiring (which group, the SPI INTID,
  edge/level sensitivity) is not yet confirmed against the SoC
  interrupt map, and the IO list states GPIO alerts/interrupts are
  controlled by the M85 management core, which is an open ownership
  question independent of the wiring. Do not add "interrupts" to a
  node until both are resolved.

properties:
  compatible:
    enum:
      - tsi,skylp-gpio-ionw
      - tsi,skylp-gpio-ione

  reg:
    maxItems: 1

  gpio-controller: true

  "#gpio-cells":
    const: 2

  gpio-line-names:
    minItems: 4
    maxItems: 8

  interrupts:
    maxItems: 1
    description:
      Chained parent SPI carrying the destination group selected by
      tsi,irq-dest-group. Absent by default; see the description above.

  interrupt-controller: true

  "#interrupt-cells":
    const: 2

  tsi,irq-dest-group:
    $ref: /schemas/types.yaml#/definitions/uint32
    minimum: 0
    maximum: 3
    default: 0
    description:
      Which of the four maskable destination groups (g0..g3) in the
      corner's interrupt collector carries this node's "interrupts"
      SPI. Not verified against hardware; meaningless without
      "interrupts".

required:
  - compatible
  - reg
  - gpio-controller
  - "#gpio-cells"

dependencies:
  interrupts: [interrupt-controller, "#interrupt-cells"]
  interrupt-controller: [interrupts]
  tsi,irq-dest-group: [interrupts]

additionalProperties: false

examples:
  - |
    gpio@13000000 {
        compatible = "tsi,skylp-gpio-ionw";
        reg = <0x13000000 0x200>;
        gpio-controller;
        #gpio-cells = <2>;
    };
```

## Documentation/devicetree/bindings/i2c/tsi,skylp-i2c.yaml
```yaml
# SPDX-License-Identifier: (GPL-2.0-only OR BSD-2-Clause)
%YAML 1.2
---
$id: http://devicetree.org/schemas/i2c/tsi,skylp-i2c.yaml#
$schema: http://devicetree.org/meta-schemas/core.yaml#

title: TSI SkyLP DWC_i2c controller

maintainers:
  - Sanjay R Mehta <smehta@tsavoritesi.com>

description: |
  Synopsys DWC_i2c v1.01a ("Advanced I2C/SMBus Controller and Target
  Device") as instantiated on TSI SkyLP. This is a different IP
  generation from the DW_apb_i2c described by snps,designware-i2c.yaml:
  the register offsets and several IC_CTRL field positions differ, so
  the two are not interchangeable and the compatibles must not be mixed.

  "reg" is the controller block offset inside the parent
  tsi,skylp-chiplet CSR window, so the parent must use
  #address-cells = <1> and #size-cells = <1>.

  The SCL/SDA pads are in the IONE IO corner, whose pad and iomode
  registers belong to the corner's pin controller
  (tsi,skylp-ione-pinctrl) and not to this controller. Mux them by
  referencing a pin-configuration node from pinctrl-0; the pinctrl core
  applies the default state before the controller probes. Without it the
  pads stay in their reset function and every transfer NACKs.

  The controller has no "interrupts" property: the driver polls
  IC_STATUS/IC_TXFLR/IC_RXFLR. The GIC routing for this block is not yet
  established in the SkyLP interrupt map, so a consumer cannot describe
  it correctly yet.

allOf:
  - $ref: /schemas/i2c/i2c-controller.yaml#

properties:
  compatible:
    const: tsi,skylp-i2c

  reg:
    maxItems: 1

  clock-frequency:
    description:
      Desired SCL bus frequency. Selects the IC_CTRL SPEED field; the
      SCL high/low counts themselves come from tsi,scl-hcnt and
      tsi,scl-lcnt.
    default: 400000

  tsi,scl-hcnt:
    $ref: /schemas/types.yaml#/definitions/uint32
    description: |
      IC_SCL_HCNT, the SCL high period in controller clocks.

      Defaulted rather than computed because the IONE MGTCLK rate is not
      yet established; the default is the value the RTL DV fast-mode
      bring-up programs. Set this once the input clock is known.
    default: 0x320

  tsi,scl-lcnt:
    $ref: /schemas/types.yaml#/definitions/uint32
    description:
      IC_SCL_LCNT, the SCL low period in controller clocks. Defaulted on
      the same basis as tsi,scl-hcnt.
    default: 0x4b0

required:
  - compatible
  - reg

unevaluatedProperties: false

examples:
  - |
    soc {
        #address-cells = <2>;
        #size-cells = <2>;

        chiplet@2040000000 {
            compatible = "tsi,skylp-chiplet";
            reg = <0x20 0x40000000 0x0 0x1c000000>;
            tsi,chiplet-id = <0>;
            #address-cells = <1>;
            #size-cells = <1>;
            ranges = <0x0 0x20 0x40000000 0x1c000000>;

            pinctrl@6000000 {
                compatible = "tsi,skylp-ione-pinctrl";
                reg = <0x6000000 0xc380>;
                gpio-controller;
                #gpio-cells = <2>;

                i2c0_pins: i2c0-pins {
                    groups = "smb";
                    function = "i2c";
                };
            };

            i2c@6002000 {
                compatible = "tsi,skylp-i2c";
                reg = <0x6002000 0x100>;
                clock-frequency = <400000>;
                pinctrl-names = "default";
                pinctrl-0 = <&i2c0_pins>;
                #address-cells = <1>;
                #size-cells = <0>;

                temperature-sensor@48 {
                    compatible = "ti,tmp75";
                    reg = <0x48>;
                };
            };
        };
    };
```

## Documentation/devicetree/bindings/interrupt-controller/tsi,skylp-intc.yaml
```yaml
# SPDX-License-Identifier: (GPL-2.0-only OR BSD-2-Clause)
%YAML 1.2
---
$id: http://devicetree.org/schemas/interrupt-controller/tsi,skylp-intc.yaml#
$schema: http://devicetree.org/meta-schemas/core.yaml#

title: TSI SkyLP interrupt collector

maintainers:
  - Mahesh Babu <maheshbabu@tsavoritesi.com>

description: |
  Interrupt collector block of a TSI SkyLP chiplet. Each instance
  latches up to 32 level-sensitive IP sources and fans them out to four
  independently maskable destination groups (g0..g3); one group is
  routed towards the application processor's GIC as an SPI, the others
  may serve other masters (e.g. the M85 management core). One node
  drives exactly one destination group.

  The first user is the GPP/UDI instance in front of the USB/DP
  subsystem (bit 0 usb_intr, bit 1 dptx_intr, bits 2-5 video bridge,
  bits 6-7 audio). The collectors inside the IO corners are handled by
  the tsi,skylp-pinctrl binding instead, since they share the corner's
  register window.

  The node is deliberately usable without "interrupts": the
  collector-to-GIC routing (which group, which SPI INTID) is not yet
  confirmed against the SoC interrupt map. Without it the driver probes
  dormant - consumers can map and request their lines, nothing
  dispatches. Note that unmasking a line arms the collector's global
  per-source enable, which is shared with the other three destination
  groups.

  Only level triggers are supported; the collector has no polarity
  control.

properties:
  compatible:
    const: tsi,skylp-intc

  reg:
    maxItems: 1
    description: |
      The collector's register window, from the pending register to the
      last destination group (0x40 bytes). This is a standalone MMIO
      window and must be left out of any tsi,skylp-chiplet node's "reg",
      which claims its whole CSR window exclusively.

  interrupts:
    maxItems: 1
    description:
      Parent SPI carrying the destination group selected by
      tsi,dest-group. Absent until the routing is confirmed; see above.

  interrupt-controller: true

  "#interrupt-cells":
    const: 2

  tsi,dest-group:
    $ref: /schemas/types.yaml#/definitions/uint32
    minimum: 0
    maximum: 3
    default: 0
    description:
      Which of the four destination groups this node owns and (with
      "interrupts") the parent SPI carries.

  tsi,num-sources:
    $ref: /schemas/types.yaml#/definitions/uint32
    minimum: 1
    maximum: 32
    default: 32
    description:
      Number of wired sources in this instance (8 for the GPP/UDI
      collector).

required:
  - compatible
  - reg
  - interrupt-controller
  - "#interrupt-cells"

additionalProperties: false

examples:
  - |
    /* GPP/UDI collector, dormant until the GIC routing is confirmed. */
    interrupt-controller@24000108 {
        compatible = "tsi,skylp-intc";
        reg = <0x24000108 0x40>;
        interrupt-controller;
        #interrupt-cells = <2>;
        tsi,dest-group = <0>;
        tsi,num-sources = <8>;
    };
```

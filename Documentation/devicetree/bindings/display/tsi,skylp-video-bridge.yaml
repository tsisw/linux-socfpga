## drivers/usb/soc_drd/Kconfig
```kconfig
# SPDX-License-Identifier: GPL-2.0

config USB_SOC_DRD
	tristate "SOC USB3 DRD Core Support"
	depends on (USB || USB_GADGET) && HAS_DMA
	depends on (EXTCON || EXTCON=n)
	select USB_XHCI_PLATFORM if USB_XHCI_HCD
	select USB_ROLE_SWITCH if USB_SOC_DRD_DUAL_ROLE
	help
	  Say Y or M here if your system has a Dual Role SuperSpeed
	  USB controller based on the SOC USB3 IP Core.

	  If you choose to build this driver as a dynamically linked
	  module, the module will be called soc_usb.ko.

if USB_SOC_DRD

choice
	bool "SOC USB Mode Selection"
	default USB_SOC_DRD_HOST if (USB && !USB_GADGET)
	default USB_SOC_DRD_GADGET if (!USB && USB_GADGET)

config USB_SOC_DRD_HOST
	bool "Host only mode"
	depends on USB=y || USB=USB_SOC_DRD
	help
	  Select this when you want to use SOC USB in host mode only,
	  thereby the gadget feature will be regressed.

config USB_SOC_DRD_GADGET
	bool "Gadget only mode"
	depends on USB_GADGET=y || USB_GADGET=USB_SOC_DRD
	help
	  Select this when you want to use SOC USB in gadget mode only,
	  thereby the host feature will be regressed.

config USB_SOC_DRD_DUAL_ROLE
	bool "Dual Role mode"
	depends on ((USB=y || USB=USB_SOC_DRD) && (USB_GADGET=y || USB_GADGET=USB_SOC_DRD))
	depends on (EXTCON=y || EXTCON=USB_SOC_DRD)
	help
	  This is the default mode of working of SOC USB3 controller where
	  both host and gadget features are enabled.

endchoice

endif

config USB_SOC_DRD_SKYLP
	tristate "TSI SkyLP integration for the SOC USB3 DRD core"
	depends on USB_SOC_DRD || COMPILE_TEST
	default USB_SOC_DRD
	help
	  Platform init sequence for the SOC USB3 DRD core as integrated
	  in the TSI SkyLP chiplet (UDI subsystem): TSAR block release,
	  UDI reference-clock select and the mandatory Type-C lane-mux
	  write (the mux resets to "no connection"). The soc_usb driver
	  runs it from its clk/phy init hook on "tsi,skylp-usb" nodes.

	  The sequence core has no USB dependencies so it can also be
	  KUnit-tested and reused by the Type-C glue driver.

config USB_SOC_DRD_SKYLP_TYPEC
	tristate "TSI SkyLP Type-C plug/orientation glue"
	depends on USB_SOC_DRD_SKYLP
	depends on GPIOLIB
	depends on TYPEC
	default USB_SOC_DRD
	help
	  Drives the SkyLP Type-C lane mux. Registers a standard Type-C
	  orientation switch and mode mux, so a port manager on a
	  source-capable board can drive it with no SkyLP-specific code,
	  and additionally follows the PD controller's plug/orientation
	  GPIO lines (TI TPS25730D on the Helix-M board) where the board
	  routes them to the SoC.

	  Without it the mux keeps its reset value, which is "no
	  connection", and no USB3 link can train.

config USB_SOC_DRD_SKYLP_KUNIT_TEST
	tristate "KUnit tests for the TSI SkyLP init-sequence core" if !KUNIT_ALL_TESTS
	depends on USB_SOC_DRD_SKYLP && KUNIT
	default KUNIT_ALL_TESTS
	help
	  KUnit tests for the SkyLP USB init-sequence core (lane-mux
	  value composition and sequence ordering). Say N unless you are
	  developing the driver.
```

## Documentation/devicetree/bindings/usb/tsi,skylp-usb.yaml
```yaml
# SPDX-License-Identifier: (GPL-2.0-only OR BSD-2-Clause)
%YAML 1.2
---
$id: http://devicetree.org/schemas/usb/tsi,skylp-usb.yaml#
$schema: http://devicetree.org/meta-schemas/core.yaml#

title: TSI SkyLP USB3.2 DRD controller (SOC USB3 DRD core)

maintainers:
  - Mahesh Babu <maheshbabu@tsavoritesi.com>

description: |
  The USB3.2 dual-role controller of the TSI SkyLP chiplet's UDI
  subsystem: the Innosilicon-integrated SOC USB3 DRD core (a
  DWC3-register-compatible IP whose ID registers are not populated, so
  it binds to the soc_drd driver, not to snps,dwc3).

  On top of the plain "soc,soc_drd3" controller node this binding adds
  the SkyLP platform init the vendor driver leaves empty: the TSAR
  block-control release, the UDI reference-clock select, and the
  mandatory Type-C lane-mux write. The mux word resets to "no
  connection", so a node without the tsi-mux window can never train a
  link.

  The TSAR and clock-select VALUES are intentionally DT-supplied
  (tsi,tsar-init / tsi,clksel-init); a step is skipped when its
  property is absent, and the mux write always happens. The TSAR bit
  assignment is still being confirmed with the hardware team; the
  clock-select bits are documented under tsi,clksel-init below.

  The optional UDI reset-release window (gpp udi_reset_cfg) is
  window-gated rather than value-gated: a board that declares it wants
  Linux to release por_n (with the validated >= 100 us settle after
  it) and the AHB/APB/USB-AXI resets; one that leaves it out had
  firmware release them. The driver read-modify-writes the word, so
  the DP/video/audio release bits stay with their own drivers.

  All windows are standalone MMIO ranges and must be left out of any
  tsi,skylp-chiplet node's "reg". The tsar/clksel words are mapped
  without claiming a region since they sit inside CSR space the chiplet
  core may own; the mux word sits inside the DP/PHY APB window the
  tsi,skylp-dp node claims.

properties:
  compatible:
    items:
      - const: tsi,skylp-usb
      - const: soc,soc_drd3

  reg:
    minItems: 2
    items:
      - description: Controller registers (xHCI window followed by the
          global registers at +0xc100)
      - description: Type-C lane-mux word
      - description: TSAR block-control word
      - description: UDI reference-clock-select word
      - description: UDI reset-release word (gpp udi_reset_cfg)

  reg-names:
    minItems: 2
    items:
      - const: usb
      - const: tsi-mux
      - const: tsi-tsar
      - const: tsi-clksel
      - const: tsi-reset

  interrupts:
    maxItems: 1

  interrupts-extended:
    maxItems: 1
    description:
      The usb_intr line usually sits behind the UDI interrupt
      collector rather than directly on the GIC, so this encoding is
      the common one (as in the example below). Exactly one of
      "interrupts" or "interrupts-extended" must be present.

  clocks:
    description:
      Clocks feeding the UDI USB subsystem. The soc_drd controller
      driver itself consumes no clocks, so the SkyLP integration
      enables every clock listed here before running the init sequence
      and holds them for the device's lifetime. Optional until the UDI
      clock topology is confirmed.
    minItems: 1
    maxItems: 4

  clock-names:
    minItems: 1
    maxItems: 4

  tsi,tsar-init:
    $ref: /schemas/types.yaml#/definitions/uint32
    description:
      Value written to the TSAR block-control word first in the init
      sequence, followed by a >= 100 us settle. Requires the tsi-tsar
      window.

  tsi,clksel-init:
    $ref: /schemas/types.yaml#/definitions/uint32
    maximum: 0x7
    description: |
      Value written to the UDI reference-clock-select word before the
      mux write. Requires the tsi-clksel window. Bits (hardware team,
      2026-10-07):
        bit 0  refclk_sel       0 single-ended, 1 differential reference
        bit 1  refclk100m_sel   0 use 50 MHz FREF, 1 use FREF_100M
        bit 2  div2_clken       feed the controller ref_clk FREF / 2
      div2_clken RESETS TO 1 (udi_clk_sel reset {0, 0, 1}), so the
      controller ref_clk is 25 MHz by default; the driver programs
      GUCTL.REFCLKPER and GCTL.PWRDNSCALE for 25 MHz unless this
      property explicitly clears div2_clken, in which case it programs
      them for the full 50 MHz FREF.

  tsi,mux-mode:
    $ref: /schemas/types.yaml#/definitions/uint32
    enum: [0, 1, 2, 3]
    default: 1
    description:
      Type-C lane-mux mode. 0 = no connection (reset value), 1 = USB3.2
      Gen2x2, 2 = USB3.2 + 2-lane DisplayPort, 3 = 4-lane DisplayPort.

  tsi,mux-flip:
    type: boolean
    description:
      Boot-time cable orientation. Runtime orientation tracking is the
      tsi,skylp-typec node's job.

  dr_mode:
    enum: [host, peripheral, otg]
    description:
      Fixed role. The controller ships no role-switching layer, so this
      is the role for the lifetime of the device.

  maximum-speed:
    $ref: /schemas/types.yaml#/definitions/string
    enum: [super-speed-plus, super-speed, high-speed, full-speed]

  phy_type:
    $ref: /schemas/types.yaml#/definitions/string
    enum: [utmi, utmi_wide]
    description:
      Width of the controller's USB 2.0 UTMI interface. Note the USB2
      PHY is off-macro on SkyLP, so this only sizes the controller-side
      interface.

  usb-psy-name:
    $ref: /schemas/types.yaml#/definitions/string
    description:
      Name of a power supply the gadget path reports its current draw
      to. Optional; absent means no reporting.

  dma-coherent: true

  iommus:
    maxItems: 1

  resets:
    maxItems: 1

  power-domains:
    maxItems: 1

patternProperties:
  # The vendor controller carries a large set of errata and threshold
  # knobs in its own namespace. They belong to the soc,soc_drd3
  # fallback, which has no binding of its own, so accept the namespace
  # rather than duplicating three dozen entries here.
  "^soc,[a-z0-9-_]+$":
    description:
      Vendor soc_drd quirk, erratum or threshold property. See the
      driver for the accepted set.

required:
  - compatible
  - reg
  - reg-names

oneOf:
  - required: [ interrupts ]
  - required: [ interrupts-extended ]

additionalProperties: false

examples:
  - |
    usb@24000150 {
        compatible = "tsi,skylp-usb", "soc,soc_drd3";
        reg = <0x24000150 0x10000>,
              <0x24021714 0x4>,
              <0x24000008 0x4>,
              <0x2400014c 0x4>;
        reg-names = "usb", "tsi-mux", "tsi-tsar", "tsi-clksel";
        /* usb_intr, line 0 of the UDI collector */
        interrupts-extended = <&udi_intc 0 4>;
        dr_mode = "host";
        maximum-speed = "super-speed-plus";
        phy_type = "utmi_wide";
        soc,dis_u3_susphy_quirk;
        soc,dis_u2_susphy_quirk;
        tsi,mux-mode = <1>;
    };
```

## drivers/gpu/drm/tsi-dp/Kconfig
```kconfig
menu "SOC DisplayPort (DP) Drivers"

config DRM_SOC_DP
	tristate "SOC DisplayPort Driver"
	depends on DRM && OF
	select DRM_DISPLAY_DP_HELPER
	select DRM_DISPLAY_HELPER
	select DRM_KMS_HELPER
	default n
	help
	  DRM/KMS driver for the SOC DisplayPort controller.
	  Supports SST (Single-Stream Transport) and MST
	  (Multi-Stream Transport) modes.

	  This driver provides the main DP encoder, connector,
	  AUX channel, and MST topology management.

	  To compile this driver as a module, choose M here:
	  the module will be called soc_dp_drm.

config DRM_SOC_DP_PHY
	tristate "SOC DisplayPort PHY Driver"
	depends on OF && COMMON_CLK
	select GENERIC_PHY
	default n
	help
	  PHY driver for the SOC DisplayPort controller.
	  Handles PLL configuration, lane rate setup, and
	  pixel clock generation.

	  To compile this driver as a module, choose M here:
	  the module will be called soc_dp_phy.

config SOC_DP_DRIVER_QEMU
	bool "SOC DP QEMU / virtual simulation mode"
	depends on DRM_SOC_DP
	default n
	help
	  Enable QEMU / software simulation mode. When enabled,
	  AUX transfers are routed to the virtual RX receiver
	  instead of real hardware registers. Hardware AUX
	  functions are excluded from compilation.

	  This is intended for development and testing in a
	  virtualized environment without real DP hardware.

	  If unsure, say N.

config SOC_DP_ACTIVATE_DO_DIV
	bool "Use do_div() for 64-bit division"
	depends on DRM_SOC_DP
	default n
	help
	  Use the kernel's do_div() helper for 64-bit division
	  operations. Required on 32-bit ARM platforms that lack
	  native 64-bit hardware division support.

	  Enabling this option includes <linux/math64.h> and
	  routes all 64-bit divisions through do_div().

	  If unsure, say N on 64-bit platforms, say Y on 32-bit
	  ARM platforms.

config SOC_DP_HOT_PLUG_THREAD_ENABLED
	bool "Use polling thread for HPD detection"
	depends on DRM_SOC_DP
	default y
	help
	  Use a delayed work polling thread for Hot Plug Detect
	  instead of a hardware interrupt line.

	  Enable this when the hardware does not provide a
	  dedicated HPD interrupt, or when using a polling-based
	  approach is preferred for reliability.

	  If unsure, say N (use hardware IRQ).

config SOC_DP_HPD_BYPASS
	bool "Bypass hardware HPD detection"
	depends on DRM_SOC_DP
	default y if DRM_TSI_SKYLP
	help
	  Bypass real hardware HPD (Hot Plug Detect) status
	  register reads. The connector status is determined
	  solely by software state, and FORCE_HPD is asserted
	  at init.

	  Used together with SOC_DP_DRIVER_QEMU in simulation,
	  and on TSI SkyLP, where the controller's pin_hpd is
	  tied low and no GPIO carries hot-plug (gap G19), so the
	  driver must force HPD. Defaults on when the TSI SkyLP
	  display driver is selected.

	  If unsure, say N.

config SOC_DP_FPGA_LIMITS
	bool "Keep the vendor's FPGA bring-up limits"
	depends on DRM_SOC_DP
	default n
	help
	  The driver ships tuned for the vendor's FPGA platform:
	  the link-rate table stops at RBR x2 (3.24 Gbps), modes
	  are capped at 640x480, the sink's bpc is forced to 8,
	  and the PHY's per-stream register stride is zero.

	  Say Y for an FPGA target (proFPGA). Say N for silicon,
	  which lifts all four limits to the vendor's own
	  commented-out values (gap G15).

endmenu
```

## drivers/gpu/drm/tsi-skylp/Kconfig
```kconfig
# SPDX-License-Identifier: GPL-2.0-only
config DRM_TSI_SKYLP
	tristate "TSI SkyLP display controller (video bridge scanout)"
	depends on DRM && OF && COMMON_CLK
	depends on ARM64 || COMPILE_TEST
	select DRM_KMS_HELPER
	select DRM_GEM_DMA_HELPER
	select DRM_TSI_SKYLP_VB
	help
	  DRM master, CRTC and primary plane for the video bridge in the
	  Innosilicon UDI subsystem of TSI SkyLP. The bridge scans a
	  physically contiguous framebuffer out to the DP controller, whose
	  encoder and connector are provided by the soc,dp component driver
	  (DRM_SOC_DP). This driver is the component master that binds it.

	  To compile this driver as a module, choose M here: the module
	  will be called tsi_skylp_drv.

config DRM_TSI_SKYLP_VB
	tristate "TSI SkyLP video bridge register core" if KUNIT
	depends on DRM
	help
	  Register encoding and programming sequences for the SkyLP video
	  bridge: mode-to-timing conversion, framebuffer address and format
	  programming, channel start and stop, and interrupt acknowledge.
	  They are kept free of DRM object state so they can be unit tested
	  on their own. Selected by DRM_TSI_SKYLP; the prompt only appears
	  in KUnit builds.

config DRM_TSI_SKYLP_KUNIT_TEST
	tristate "KUnit tests for the TSI SkyLP video bridge core" if !KUNIT_ALL_TESTS
	depends on DRM_TSI_SKYLP_VB && KUNIT
	default KUNIT_ALL_TESTS
	help
	  Unit tests for the video bridge programming core. They cover mode
	  to timing conversion and its field limits, the accepted pixel
	  formats, the 40-bit and 4 GiB scanout address rules, page-flip
	  slot alternation and write order, and the interrupt acknowledge
	  sequence. They run against a fake register file.

	  If unsure, say N.
```

## drivers/pinctrl/tsi/Kconfig
```kconfig
# SPDX-License-Identifier: GPL-2.0-only

config PINCTRL_TSI
	tristate "TSI chiplet IO-corner pinctrl and GPIO"
	depends on OF
	depends on TSI_CHIPLET || COMPILE_TEST
	select GENERIC_PINCONF
	select GENERIC_PINCTRL_GROUPS
	select GENERIC_PINMUX_FUNCTIONS
	select GPIOLIB
	select GPIOLIB_IRQCHIP
	select REGMAP
	help
	  Combined pinctrl and GPIO driver for the IO corners of a TSI
	  chiplet. SkyLP (IONW, IONE, IOSE, IOSW) is the only chiplet
	  described today; other chiplets add their own pad tables to the
	  same driver. Registers are reached through the TSI chiplet core
	  driver.

	  Most corner pads are multiplexed between an on-chip peripheral
	  (SPI/QSPI/OSPI, I2C/SMB, I3C, UART, I2S, PCIe PERST/MDIO, LED,
	  PWM) and GPIO. The hardware selects a function for a whole pad
	  group at once, not per pad, so a devicetree node should claim a
	  complete group.

	  This driver supersedes GPIO_TSI, which only handled the pads
	  that have no alternate function. Do not enable both for the
	  same corner.

config PINCTRL_TSI_KUNIT_TEST
	tristate "KUnit tests for the TSI pinctrl driver" if !KUNIT_ALL_TESTS
	depends on PINCTRL_TSI && KUNIT
	default KUNIT_ALL_TESTS
	help
	  Builds unit tests for the TSI pinctrl/GPIO driver: pad to
	  data-bit mapping, iomode (mux) encodings, group-wide muxing,
	  OE/IE direction encoding, write ordering and pin configuration,
	  all against a fake register model instead of hardware. Runs
	  under UML via tools/testing/kunit/kunit.py.

	  Say N unless you are developing the driver.
```

## drivers/soc/tsi/Kconfig
```kconfig
# SPDX-License-Identifier: GPL-2.0-only

menu "TSI SoC drivers"
	depends on ARCH_TSI || COMPILE_TEST

config TSI_CHIPLET
	tristate "TSI chiplet CSR window core"
	depends on OF
	select REGMAP_MMIO
	help
	  Core driver for the TSI chiplet CSR window. Maps the window,
	  provides a regmap and poll helpers, and probes the IP blocks
	  (gpio, pvt, mbox, i2c, wdt) declared as DT children. All TSI IP
	  drivers depend on it.

endmenu
```

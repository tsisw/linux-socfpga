## Documentation/devicetree/bindings/pinctrl/tsi,skylp-pinctrl.yaml
```yaml
# SPDX-License-Identifier: (GPL-2.0-only OR BSD-2-Clause)
%YAML 1.2
---
$id: http://devicetree.org/schemas/pinctrl/tsi,skylp-pinctrl.yaml#
$schema: http://devicetree.org/meta-schemas/core.yaml#

title: TSI SkyLP IO-corner pin controller and GPIO

maintainers:
  - Tsavorite Scalable Intelligence platform team

description: |
  One node describes one IO corner of a TSI SkyLP chiplet. A corner owns
  a set of pads and provides both a pin controller and a GPIO controller
  for them; "reg" is the corner block offset inside the parent
  tsi,skylp-chiplet CSR window.

  Pads are multiplexed in groups. A single iomode register selects the
  function for a whole group, so a group cannot be split between two
  functions: claiming one pad of the "spi" group as GPIO moves all
  twelve. Describe a complete group in each pinmux node.

  GPIO line numbers are the pad's bit in the corner's shared
  gpio_data_out/gpio_data_in registers, which is not the pad's position
  in the corner's address map. On IONW, GPIO_0..3 are lines 0..3 while
  GPIO_4..7 are lines 21..24.

  Only pads with a bit in those data registers are exposed. Pads that
  have a control register but no data bit are not GPIO-capable and are
  absent from this binding: the IOSE straps (Chip_ID, CHIP_PRIM,
  PKG_PRIM), the IOSW JTAG/cJTAG/TPI pads, and the IONE PLL_FOUT pad.

  Some pads may be owned by the M85 management core, which runs its own
  OS and is not arbitrated against by Linux. Only describe pads that are
  assigned to the application processor.

  Pin events latch in one of the corner's interrupt collectors, which
  fans out to four maskable destination groups; one of them is meant to
  reach the A520 GIC as an SPI. The driver can act as an
  interrupt-controller, but stays dormant unless "interrupts" is
  present: the collector-to-GIC wiring (which group, the SPI INTID) is
  not yet confirmed against the SoC interrupt map, and the IO list
  states GPIO alerts are controlled by the M85, which is a separate
  ownership question. Do not add "interrupts" to a node until both are
  resolved. Note also that arming a line writes the collector's global
  per-source enable, which is shared with the other three destination
  groups.

  Only level triggers are supported; the collector has no polarity
  control, so edge and mixed edge/level requests are rejected.

properties:
  compatible:
    enum:
      - tsi,skylp-ionw-pinctrl
      - tsi,skylp-ione-pinctrl
      - tsi,skylp-iose-pinctrl
      - tsi,skylp-iosw-pinctrl

  reg:
    maxItems: 1
    description: |
      Offset and size of the corner's register window inside the parent
      chiplet's CSR window, so the parent must use #address-cells = <1>
      and #size-cells = <1>. The window has to cover every register the
      corner uses, which extends past the pad and iomode registers as
      far as the interrupt collector's last destination group:

        tsi,skylp-ionw-pinctrl   minimum size 0x3500
        tsi,skylp-ione-pinctrl   minimum size 0xc380
        tsi,skylp-iose-pinctrl   minimum size 0x2080
        tsi,skylp-iosw-pinctrl   minimum size 0x9100

      A smaller window is rejected at probe: the parent regmap spans the
      whole chiplet, so undersized nodes would otherwise be written
      straight through and corrupt neighbouring blocks.

  gpio-controller: true

  "#gpio-cells":
    const: 2

  gpio-line-names:
    minItems: 2
    maxItems: 26

  interrupts:
    maxItems: 1
    description:
      Parent SPI carrying the interrupt-collector destination group
      selected by tsi,irq-dest-group. Absent by default; see below.

  interrupt-controller: true

  "#interrupt-cells":
    const: 2

  tsi,irq-dest-group:
    $ref: /schemas/types.yaml#/definitions/uint32
    minimum: 0
    maximum: 3
    default: 0
    description:
      Which of the four maskable destination groups (g0..g3) of the
      corner's interrupt collector carries this node's "interrupts"
      SPI. Meaningless without "interrupts".

required:
  - compatible
  - reg
  - gpio-controller
  - "#gpio-cells"

dependencies:
  interrupts: [interrupt-controller, "#interrupt-cells"]
  interrupt-controller: [interrupts]
  tsi,irq-dest-group: [interrupts]

allOf:
  # The number of GPIO lines is fixed per corner by the width of its
  # gpio_data registers, so gpio-line-names cannot be an arbitrary count.
  - if:
      properties:
        compatible:
          contains:
            const: tsi,skylp-ionw-pinctrl
    then:
      properties:
        gpio-line-names:
          minItems: 26
          maxItems: 26
  - if:
      properties:
        compatible:
          contains:
            const: tsi,skylp-ione-pinctrl
    then:
      properties:
        gpio-line-names:
          minItems: 25
          maxItems: 25
  - if:
      properties:
        compatible:
          contains:
            const: tsi,skylp-iose-pinctrl
    then:
      properties:
        gpio-line-names:
          minItems: 2
          maxItems: 2
  - if:
      properties:
        compatible:
          contains:
            const: tsi,skylp-iosw-pinctrl
    then:
      properties:
        gpio-line-names:
          minItems: 12
          maxItems: 12

patternProperties:
  '-pins$':
    type: object
    description:
      A pin-configuration node. Selects a function for one or more pad
      groups and/or applies electrical settings to them.

    properties:
      groups:
        description: Pad groups to configure.
        items:
          enum: [ gpio, gpio_fs, pcie, perst01, perst23, perst, spi,
                  smb, i3c, i2s, uart0, uart1, led, pwm ]

      function:
        description: |
          Function to mux onto the listed groups. Valid values depend on
          the group: "spi" accepts ospi, armspi_qspi, qspi, armspi_dspi,
          armspi_spi or gpio; "smb" accepts smb, i2c or gpio; "perst01"
          and "perst" accept perst, mdio or gpio; the remaining muxable
          groups accept their peripheral name or gpio. The dedicated
          "gpio"/"gpio_fs" groups accept only gpio.
        enum: [ gpio, ospi, armspi_qspi, qspi, armspi_dspi, armspi_spi,
                smb, i2c, i3c, i2s, uart, led, pwm, pcie, perst, mdio ]

      drive-strength:
        description: Pad drive strength in mA.
        enum: [ 3, 4, 5, 6, 8, 10 ]

      bias-pull-up: true
      bias-pull-down: true
      bias-disable: true
      input-schmitt-enable: true
      input-enable: true
      output-enable: true

    additionalProperties: false

additionalProperties: false

examples:
  - |
    chiplet@2040000000 {
        compatible = "tsi,skylp-chiplet";
        reg = <0x20 0x40000000 0x0 0x1c000000>;
        tsi,chiplet-id = <0>;
        #address-cells = <1>;
        #size-cells = <1>;
        ranges = <0x0 0x20 0x40000000 0x1c000000>;

        pinctrl@13000000 {
            compatible = "tsi,skylp-ionw-pinctrl";
            reg = <0x13000000 0x3500>;
            gpio-controller;
            #gpio-cells = <2>;

            /* Repurpose the whole SPI block as GPIO. */
            spi-gpio-pins {
                groups = "spi";
                function = "gpio";
                drive-strength = <5>;
            };

            /* Dedicated GPIO pads, pulled up as inputs. */
            gpio-in-pins {
                groups = "gpio";
                function = "gpio";
                bias-pull-up;
                input-enable;
            };
        };
    };
```

## Documentation/devicetree/bindings/soc/tsi/tsi,skylp-chiplet.yaml
```yaml
# SPDX-License-Identifier: (GPL-2.0-only OR BSD-2-Clause)
%YAML 1.2
---
$id: http://devicetree.org/schemas/soc/tsi/tsi,skylp-chiplet.yaml#
$schema: http://devicetree.org/meta-schemas/core.yaml#

title: TSI SKYLP chiplet CSR window

maintainers:
  - Tsavorite Scalable Intelligence BMC team

description:
  One TSI chiplet exposes its control/status registers through a single
  CSR window. The chiplet core owns the window and provides register
  access to the IP blocks (gpio, pvt, mbox, i2c, wdt), which are
  declared as children addressed by offset within the window.

properties:
  compatible:
    const: tsi,skylp-chiplet

  reg:
    maxItems: 1

  tsi,chiplet-id:
    $ref: /schemas/types.yaml#/definitions/uint32
    description: Logical chiplet index used for CSR request tagging.

  "#address-cells":
    const: 1

  "#size-cells":
    const: 1

  ranges: true

patternProperties:
  "^(gpio|pvt|mailbox|i2c|watchdog)@[0-9a-f]+$":
    type: object

required:
  - compatible
  - reg
  - tsi,chiplet-id
  - ranges

additionalProperties: false

examples:
  - |
    soc {
        #address-cells = <2>;
        #size-cells = <2>;

        chiplet@2040000000 {
            compatible = "tsi,skylp-chiplet";
            reg = <0x20 0x40000000 0x0 0x1c000000>;
            tsi,chiplet-id = <0>;
            #address-cells = <1>;
            #size-cells = <1>;
            ranges = <0x0 0x20 0x40000000 0x1c000000>;

            gpio@13000000 {
                compatible = "tsi,skylp-gpio-ionw";
                reg = <0x13000000 0x200>;
                gpio-controller;
                #gpio-cells = <2>;
            };
        };
    };
```

## Documentation/devicetree/bindings/usb/tsi,skylp-typec.yaml
```yaml
# SPDX-License-Identifier: (GPL-2.0-only OR BSD-2-Clause)
%YAML 1.2
---
$id: http://devicetree.org/schemas/usb/tsi,skylp-typec.yaml#
$schema: http://devicetree.org/meta-schemas/core.yaml#

title: TSI SkyLP Type-C plug/orientation glue

maintainers:
  - Mahesh Babu <maheshbabu@tsavoritesi.com>

description: |
  Driver for the TSI SkyLP Type-C lane mux. The mux register selects the
  lane mode (USB 3.2, USB + 2-lane DisplayPort, or 4-lane DisplayPort)
  and the cable orientation, so this node is both a Type-C mode switch
  and an orientation switch.

  On a board with a Type-C port manager, add "mode-switch",
  "orientation-switch" and the "port" graph link; the port manager then
  drives the mux through the usual Type-C interfaces and no other
  properties are needed.

  Helix-M has no port manager: it has no TCPC, and its TI TPS25730D PD
  controller is autonomous and sink-only. There the mux is driven from
  the board's own signals instead - the PD controller reports plug state
  and cable orientation on GPIO lines, and this node follows whichever of
  them the board routes to the SoC. They are polled, because the SkyLP
  GPIO interrupt path is level-only and the pad routing is unconfirmed.
  Note that on Helix-M only the plug-event line reaches the SoC; the
  orientation line terminates on the board CPLD, so the mux necessarily
  runs at a fixed orientation.

  With neither the switch properties nor the GPIOs, the node programs a
  fixed mode and orientation once at probe - which is still mandatory,
  because the mux resets to "no connection".

  The mux word sits inside the DP/PHY APB window the DP node claims, so
  it is mapped without claiming a region.

properties:
  compatible:
    const: tsi,skylp-typec

  reg:
    maxItems: 1
    description: The Type-C lane-mux word.

  plug-event-gpios:
    maxItems: 1
    description: PD controller's plug-detect line (TPS25730D
      USB_PLUG_EVENT). Polarity comes from the GPIO flags.

  plug-flip-gpios:
    maxItems: 1
    description: PD controller's cable-orientation line (TPS25730D
      USB_PLUG_FLIP). Polarity comes from the GPIO flags.

  tsi,mux-mode:
    $ref: /schemas/types.yaml#/definitions/uint32
    enum: [0, 1, 2, 3]
    default: 1
    description:
      Initial Type-C lane-mux mode, and the mode held while updating the
      flip bit when no port manager is present. 0 = no connection (the
      reset value), 1 = USB3.2 Gen2x2, 2 = USB3.2 + 2-lane DisplayPort,
      3 = 4-lane DisplayPort. A port manager overrides this at runtime.

  mode-switch:
    type: boolean
    description:
      Present when a Type-C port manager drives the lane mode through
      this node. Requires "port".

  orientation-switch:
    type: boolean
    description:
      Present when a Type-C port manager drives the cable orientation
      through this node. Requires "port".

  port:
    $ref: /schemas/graph.yaml#/properties/port
    description:
      Graph link to the Type-C controller that drives the mode and
      orientation switches. Absent on boards without a port manager.

required:
  - compatible
  - reg

additionalProperties: false

examples:
  - |
    #include <dt-bindings/gpio/gpio.h>

    typec@24021714 {
        compatible = "tsi,skylp-typec";
        reg = <0x24021714 0x4>;
        plug-event-gpios = <&ionw_pinctrl 4 GPIO_ACTIVE_HIGH>;
        plug-flip-gpios = <&ionw_pinctrl 5 GPIO_ACTIVE_HIGH>;
        tsi,mux-mode = <1>;
    };
```
